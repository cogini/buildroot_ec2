## configs/ec2_defconfig
```kconfig
BR2_x86_64=y
BR2_DL_DIR="$(TOPDIR)/../.dl"
BR2_CCACHE=y
BR2_CCACHE_DIR="$(TOPDIR)/../.buildroot-ccache"
BR2_TOOLCHAIN_BUILDROOT_GLIBC=y
BR2_ROOTFS_DEVICE_CREATION_DYNAMIC_EUDEV=y
BR2_ROOTFS_DEVICE_TABLE="$(BR2_EXTERNAL_EC2_PATH)/board/ec2/device_table.txt"
BR2_TARGET_GENERIC_ROOT_PASSWD="iak7Yaesei7Ohx"
BR2_TARGET_GENERIC_GETTY_PORT="ttyS0"
BR2_SYSTEM_DHCP="eth0"
BR2_ROOTFS_OVERLAY="BR2_ROOTFS_OVERLAY=$(BR2_EXTERNAL_EC2_PATH)/board/ec2/overlay/"
BR2_ROOTFS_POST_IMAGE_SCRIPT="$(BR2_EXTERNAL_EC2_PATH)/board/ec2/post-image.sh support/scripts/genimage.sh"
BR2_ROOTFS_POST_SCRIPT_ARGS="-c $(BR2_EXTERNAL_EC2_PATH)/board/ec2/genimage.cfg"
BR2_LINUX_KERNEL=y
BR2_LINUX_KERNEL_USE_CUSTOM_CONFIG=y
BR2_LINUX_KERNEL_CUSTOM_CONFIG_FILE="$(BR2_EXTERNAL_EC2_PATH)/board/ec2/linux.config"
BR2_LINUX_KERNEL_INSTALL_TARGET=y
BR2_LINUX_KERNEL_NEEDS_HOST_LIBELF=y
BR2_PACKAGE_ACPID=y
BR2_PACKAGE_CONNMAN=y
BR2_PACKAGE_CONNMAN_CLIENT=y
BR2_PACKAGE_OPENSSH=y
BR2_PACKAGE_WPA_SUPPLICANT=y
BR2_PACKAGE_WPA_SUPPLICANT_DBUS_NEW=y
BR2_TARGET_ROOTFS_EXT2=y
BR2_TARGET_ROOTFS_EXT2_4=y
BR2_TARGET_ROOTFS_EXT2_LABEL="target-root"
BR2_TARGET_ROOTFS_EXT2_SIZE="120M"
BR2_TARGET_ROOTFS_TAR_XZ=y
BR2_TARGET_GRUB2=y
BR2_TARGET_GRUB2_BUILTIN_MODULES="boot linux ext2 fat squash4 part_msdos part_gpt normal biosdisk gzio xzio lzopio"
BR2_PACKAGE_HOST_FWUP=y
BR2_PACKAGE_HOST_GENIMAGE=y
```

## configs/ec2_systemd_defconfig
```kconfig
BR2_x86_64=y
BR2_DL_DIR="$(TOPDIR)/../.dl"
BR2_CCACHE=y
BR2_CCACHE_DIR="$(TOPDIR)/../.buildroot-ccache"
BR2_TOOLCHAIN_BUILDROOT_GLIBC=y
BR2_INIT_SYSTEMD=y
BR2_ROOTFS_DEVICE_TABLE="$(BR2_EXTERNAL_EC2_PATH)/board/ec2/device_table.txt"
BR2_TARGET_GENERIC_ROOT_PASSWD="Thaif5ai"
BR2_TARGET_GENERIC_GETTY_PORT="ttyS0"
BR2_SYSTEM_DHCP="eth0"
BR2_ROOTFS_OVERLAY="$(BR2_EXTERNAL_EC2_PATH)/board/ec2/systemd/rootfs_overlay/"
BR2_ROOTFS_POST_BUILD_SCRIPT="$(BR2_EXTERNAL_EC2_PATH)/board/ec2/systemd/pre-image.sh"
BR2_ROOTFS_POST_IMAGE_SCRIPT="$(BR2_EXTERNAL_EC2_PATH)/board/ec2/post-image.sh support/scripts/genimage.sh"
BR2_ROOTFS_POST_SCRIPT_ARGS="-c $(BR2_EXTERNAL_EC2_PATH)/board/ec2/genimage.cfg"
BR2_LINUX_KERNEL=y
BR2_LINUX_KERNEL_USE_CUSTOM_CONFIG=y
BR2_LINUX_KERNEL_CUSTOM_CONFIG_FILE="$(BR2_EXTERNAL_EC2_PATH)/board/ec2/linux.config"
BR2_LINUX_KERNEL_INSTALL_TARGET=y
BR2_LINUX_KERNEL_NEEDS_HOST_LIBELF=y
BR2_PACKAGE_GZIP=y
BR2_PACKAGE_BLKTRACE=y
BR2_PACKAGE_ACPID=y
BR2_PACKAGE_DMIDECODE=y
BR2_PACKAGE_PCIUTILS=y
BR2_PACKAGE_PYTHON3=y
BR2_PACKAGE_PYTHON3_CURSES=y
BR2_PACKAGE_RUBY=y
BR2_PACKAGE_LIBNL=y
BR2_PACKAGE_CONNMAN=y
BR2_PACKAGE_CONNMAN_CLIENT=y
BR2_PACKAGE_OPENSSH=y
BR2_PACKAGE_AUDIT=y
BR2_PACKAGE_HTOP=y
BR2_PACKAGE_SYSTEMD_POLKIT=y
BR2_PACKAGE_TAR=y
BR2_TARGET_ROOTFS_EXT2=y
BR2_TARGET_ROOTFS_EXT2_4=y
BR2_TARGET_ROOTFS_EXT2_LABEL="target-root"
BR2_TARGET_ROOTFS_EXT2_SIZE="300M"
BR2_TARGET_ROOTFS_TAR_XZ=y
BR2_TARGET_GRUB2=y
BR2_TARGET_GRUB2_BUILTIN_MODULES="boot linux ext2 fat squash4 part_msdos part_gpt normal biosdisk gzio xzio lzopio echo"
BR2_PACKAGE_HOST_FWUP=y
BR2_PACKAGE_HOST_GENIMAGE=y
```

## package/erlang-app/Config.in
```kconfig
config BR2_PACKAGE_ERLANG_APP
    bool "erlang-app"
    depends on BR2_PACKAGE_ERLANG
    help
      Sets up system for an app which will be deployed via an Erlang release.

      http://www.cogini.com/

comment "erlang-app needs erlang"
    depends on !BR2_PACKAGE_ERLANG
```
